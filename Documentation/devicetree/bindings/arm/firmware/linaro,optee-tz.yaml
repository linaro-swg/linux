## Documentation/devicetree/bindings/arm/firmware/linaro,optee-tz.yaml
```yaml
# SPDX-License-Identifier: (GPL-2.0 OR BSD-2-Clause)
%YAML 1.2
---
$id: http://devicetree.org/schemas/arm/firmware/linaro,optee-tz.yaml#
$schema: http://devicetree.org/meta-schemas/core.yaml#

title: OP-TEE

maintainers:
  - Jens Wiklander <jens.wiklander@linaro.org>

description: |
  OP-TEE is a piece of software using hardware features to provide a Trusted
  Execution Environment. The security can be provided with ARM TrustZone, but
  also by virtualization or a separate chip.

  We're using "linaro" as the first part of the compatible property for
  the reference implementation maintained by Linaro.

properties:
  $nodename:
    const: optee

  compatible:
    const: linaro,optee-tz

  interrupts:
    maxItems: 1
    description: |
      This interrupt which is used to signal an event by the secure world
      software is expected to be edge-triggered.

  method:
    enum: [smc, hvc]
    description: |
      The method of calling the OP-TEE Trusted OS depending on smc or hvc
      instruction usage.
      SMC #0, register assignments
      or
      HVC #0, register assignments
      register assignments are specified in drivers/tee/optee/optee_smc.h

  interrupt-controller: true

  "#interrupt-cells":
    const: 1
    description: |
      OP-TEE exposes irq for irp chip controllers from OP-TEE world. Each
      irq is assigned a single line number identifier used as first argument.
      Line number identifiers and their meaning shall be found in the OP-TEE
      firmware platform documentation.

required:
  - compatible
  - method

additionalProperties: false

examples:
  - |
    #include <dt-bindings/interrupt-controller/arm-gic.h>
    firmware  {
        optee  {
            compatible = "linaro,optee-tz";
            method = "smc";
            interrupts = <GIC_SPI 187 IRQ_TYPE_EDGE_RISING>;
        };
    };

  - |
    firmware  {
        optee  {
            compatible = "linaro,optee-tz";
            method = "hvc";
        };
    };

  - |
    #include <dt-bindings/interrupt-controller/arm-gic.h>
    firmware  {
        optee: optee {
            compatible = "linaro,optee-tz";
            method = "smc";
            interrupt-parent = <&gic>;
            interrupts = <GIC_SPI 187 IRQ_TYPE_EDGE_RISING>;
            interrupt-controller;
            #interrupt-cells = <1>;
        };

        scmi {
            compatible = "linaro,scmi-optee";
            linaro,optee-channel-id = <0>;
            shmem = <&scmi_shm_tx>, <&scmi_shm_rx>;
            interrupts-extended = <&optee 5>;
            interrupt-names = "a2p";
            #address-cells = <1>;
            #size-cells = <0>;

            scmi_cpu_dvfs: protocol@13 {
                reg = <0x13>;
                #clock-cells = <1>;
            };
        };
    };
```

## Documentation/devicetree/bindings/reserved-memory/linaro,secure-heap.yaml
```yaml
# SPDX-License-Identifier: (GPL-2.0 OR BSD-2-Clause)
%YAML 1.2
---
$id: http://devicetree.org/schemas/reserved-memory/linaro,secure-heap.yaml#
$schema: http://devicetree.org/meta-schemas/core.yaml#

title: Linaro Secure DMABUF Heap

maintainers:
  - Olivier Masse <olivier.masse@nxp.com>

description:
  Linaro OP-TEE firmware needs a reserved memory for the
  Secure Data Path feature (aka SDP).
  The purpose is to provide a secure memory heap which allow
  non-secure OS to allocate/free secure buffers.
  The TEE is reponsible for protecting the SDP memory buffers.
  TEE Trusted Application can access secure memory references
  provided as parameters (DMABUF file descriptor).

allOf:
  - $ref: "reserved-memory.yaml"

properties:
  compatible:
    const: linaro,secure-heap

  reg:
    description:
      Region of memory reserved for OP-TEE SDP feature

  no-map:
    $ref: /schemas/types.yaml#/definitions/flag
    description:
      Avoid creating a virtual mapping of the region as part of the OS'
      standard mapping of system memory.

unevaluatedProperties: false

required:
  - compatible
  - reg
  - no-map

examples:
  - |
  reserved-memory {
    #address-cells = <2>;
    #size-cells = <2>;

    sdp@3e800000 {
      compatible = "linaro,secure-heap";
      no-map;
      reg = <0 0x3E800000 0 0x00400000>;
    };
  };
```

## drivers/dma-buf/heaps/Kconfig
```kconfig
menuconfig DMABUF_HEAPS_DEFERRED_FREE
	bool "DMA-BUF heaps deferred-free library"
	help
	  Choose this option to enable the DMA-BUF heaps deferred-free library.

menuconfig DMABUF_HEAPS_PAGE_POOL
	bool "DMA-BUF heaps page-pool library"
	help
	  Choose this option to enable the DMA-BUF heaps page-pool library.

config DMABUF_HEAPS_SYSTEM
	bool "DMA-BUF System Heap"
	depends on DMABUF_HEAPS
	help
	  Choose this option to enable the system dmabuf heap. The system heap
	  is backed by pages from the buddy allocator. If in doubt, say Y.

config DMABUF_HEAPS_CMA
	bool "DMA-BUF CMA Heap"
	depends on DMABUF_HEAPS && DMA_CMA
	help
	  Choose this option to enable dma-buf CMA heap. This heap is backed
	  by the Contiguous Memory Allocator (CMA). If your system has these
	  regions, you should say Y here.

config DMABUF_HEAPS_SECURE
	tristate "DMA-BUF Secure Heap"
	depends on DMABUF_HEAPS && DMABUF_HEAPS_DEFERRED_FREE
	help
	  Choose this option to enable the secure dmabuf heap. The secure heap
	  pools are defined according to the DT. Heaps are allocated
	  in the pools using gen allocater.
	  If in doubt, say Y.
```

## drivers/tee/optee/Kconfig
```kconfig
# OP-TEE Trusted Execution Environment Configuration
config OPTEE
	tristate "OP-TEE"
	depends on HAVE_ARM_SMCCC
	help
	  This implements the OP-TEE Trusted Execution Environment (TEE)
	  driver.

config OPTEE_BENCHMARK
	tristate "OP-TEE Benchmarking"
	depends on OPTEE
	help
	  This enables benchmarking feature in the OP-TEE Trusted
	  Execution Environment (TEE) driver.
```
